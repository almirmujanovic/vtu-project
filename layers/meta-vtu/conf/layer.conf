## layers/meta-vtu/conf/layer.conf
```bitbake
# Layer configuration for meta-vtu
# This file tells BitBake about our layer

# BBPATH: Where BitBake looks for configuration files
# We add our layer's root to the search path
BBPATH .= ":${LAYERDIR}"

# BBFILES: Which recipe files (.bb) to include from this layer
# This pattern matches all .bb and .bbappend files in recipes-* directories
BBFILES += "${LAYERDIR}/recipes-*/*/*.bb \
            ${LAYERDIR}/recipes-*/*/*.bbappend"

# Collection name: unique identifier for this layer
BBFILE_COLLECTIONS += "meta-vtu"

# Pattern to match files belonging to this layer (used for debugging/tracking)
BBFILE_PATTERN_meta-vtu = "^${LAYERDIR}/"

# Priority: Higher number = higher priority (overrides lower priority layers)
# Typical values: 1-10 for BSP/base, 5-10 for distro, 10+ for custom
BBFILE_PRIORITY_meta-vtu = "10"

# Declare compatibility with Yocto releases
# This prevents using the layer with incompatible versions
LAYERSERIES_COMPAT_meta-vtu = "scarthgap"

# Layer dependencies: which other layers must be present
# BitBake will error if these aren't in bblayers.conf
LAYERDEPENDS_meta-vtu = "core openembedded-layer meta-python networking-layer"
```
